#include "lcd.h"

void delay(UINT16 i)
{
    UINT16 j,k;
   for(j=0;j<i;j++)
     for(k=0;k<110;k++);
}

void send_command(UINT8 data)
{
    UINT8 i;
   PIN_LCD_SEL=0;//Selected LCD
   PIN_LCD_A0_RS=0;//command
   for(i=0;i<8;i++)
   {
       PIN_LCD_SCLK=0;
     if(data&0x80)
         PIN_LCD_SDATA=1;
     else
         PIN_LCD_SDATA=0;
     PIN_LCD_SCLK=1;
     data= data <<1;
   }
}

void send_data(UINT8 data)
{
    UINT8 i;
   PIN_LCD_SEL=0;//Selected LCD
   PIN_LCD_A0_RS=1;;//data
   for(i=0;i<8;i++)
   {
       PIN_LCD_SCLK=0;
     if(data&0x80)
         PIN_LCD_SDATA=1;
     else
         PIN_LCD_SDATA=0;
     PIN_LCD_SCLK=1;
     data= data <<1;
   }
}

void lcd_clear(unsigned char data1)
{
                                    //------¨°???¨ş????¨˘3¨ŹD¨°
    unsigned char seg;
   unsigned char page;
   for(page=0xb0;page<0xb9;page++) //DĄä¨°3ŚĚ??Ą¤128 ¨°3 0xb0----0xb8
    {
      send_command(page);
      send_command(0x10); //¨˘DŚĚ??Ą¤Ąę???ŚĚ¨ŞĄÁ??¨˛¨˘?Ąä?DĄä¨¨?Ąę?Ąä¨ŽŚĚ¨˛0 ¨˘D?a¨ş?
      send_command(0x00);
      for(seg=0;seg<128;seg++)//DĄä128 ¨˘D
        {
          if(data1==1)send_data(0x00);
          else 	send_data(0xFF);
				}
    }
}

void lcd_GPIO_init(void)
{
    PIN_LCD_LED_direc	   = Output;
    PIN_LCD_LED_CR1=1;
    PIN_LCD_LED=1;
    PIN_LCD_SDATA_direc    = Output;
    PIN_LCD_SDATA_CR1=1;
    PIN_LCD_SDATA=0;
    PIN_LCD_SEL_direc	   = Output;
    PIN_LCD_SEL_CR1=1;
    PIN_LCD_SEL=0;
    PIN_LCD_RST_direc	   = Output;
    PIN_LCD_RST_CR1=1;
    PIN_LCD_RST=0;
    PIN_LCD_SCLK_direc	   = Output;
    PIN_LCD_SCLK_CR1=1;
    PIN_LCD_SCLK=0;
    PIN_LCD_A0_RS_direc    = Output;
    PIN_LCD_A0_RS_CR1=1;
    PIN_LCD_A0_RS=0;
}

void lcd_init(void)
{
   PIN_LCD_SEL=0;;  //Selected LCD
   PIN_LCD_RST=0; //Reset
   delay(100);
   PIN_LCD_RST=1;;//Reset OK
   delay(20);
   send_command(0xe2);//LCD soft Reset
   delay(5);
   send_command(0x2c);//Booster ratio set1
   delay(5);
   send_command(0x2e);//Booster ratio set2
   delay(5);
   send_command(0x2f);//Booster ratio set3
   delay(5);
   send_command(0x24);//Coarse contrast
   send_command(0x81);//Contrast trimming
   send_command(0x1a);//Contrast trimming ,Value
   send_command(0xa2);//1/9 LCD bias set)
   send_command(0xc8);//Common output mode select
   send_command(0xa0);//Column scanning*/
   send_command(0x40);//The initial line of display settings
   send_command(0xaf); //display ON

   lcd_clear(1);

   PIN_LCD_SEL=1;// not Selected LCD
}

void display_map_xy(unsigned char x,unsigned char y,unsigned char l,unsigned char h,const unsigned char *p)
{
   unsigned char i;
   unsigned char seg;
   unsigned char page;
   unsigned char com0,com1;
   com1=x/16+0x10;
   com0=x%16;
   for(i=0;i<h/8;i++)
   {
      page=0xb0+i+y/8;
      send_command(page);
      send_command(com1);  //列地址，高低字节两次写入，从第0 列开始
      send_command(com0);
      for(seg=x;seg<(l+x);seg++) //写128 列
        { send_data(*p++); }
   }
}

void lcd_clear_1and2_line(unsigned char data1)
{
                                    //------¨°???¨ş????¨˘3¨ŹD¨°
    unsigned char seg;
   unsigned char page;
   for(page=0xb0;page<0xb2;page++) //DĄä¨°3ŚĚ??Ą¤128 ¨°3 0xb0----0xb8
    {
      send_command(page);
      send_command(0x10); //¨˘DŚĚ??Ą¤Ąę???ŚĚ¨ŞĄÁ??¨˛¨˘?Ąä?DĄä¨¨?Ąę?Ąä¨ŽŚĚ¨˛0 ¨˘D?a¨ş?
      send_command(0x00);
      for(seg=0;seg<128;seg++)//DĄä128 ¨˘D
        {
          if(data1==1)send_data(0x00);
          else 	send_data(0xFF);
				}
    }
}

void lcd_clear_3and8_line(unsigned char data1)
{
                                    //------¨°???¨ş????¨˘3¨ŹD¨°
    unsigned char seg;
   unsigned char page;
   for(page=0xb2;page<0xb9;page++) //DĄä¨°3ŚĚ??Ą¤128 ¨°3 0xb0----0xb8
    {
      send_command(page);
      send_command(0x10); //¨˘DŚĚ??Ą¤Ąę???ŚĚ¨ŞĄÁ??¨˛¨˘?Ąä?DĄä¨¨?Ąę?Ąä¨ŽŚĚ¨˛0 ¨˘D?a¨ş?
      send_command(0x00);
      for(seg=0;seg<128;seg++)//DĄä128 ¨˘D
        {
          if(data1==1)send_data(0x00);
          else 	send_data(0xFF);
				}
    }
}

void lcd_clear_line1(unsigned char data1)
{
                                    //------¨°???¨ş????¨˘3¨ŹD¨°
    unsigned char seg;
   unsigned char page;
   for(page=0xb0;page<0xb1;page++) //DĄä¨°3ŚĚ??Ą¤128 ¨°3 0xb0----0xb8
    {
      send_command(page);
      send_command(0x10); //¨˘DŚĚ??Ą¤Ąę???ŚĚ¨ŞĄÁ??¨˛¨˘?Ąä?DĄä¨¨?Ąę?Ąä¨ŽŚĚ¨˛0 ¨˘D?a¨ş?
      send_command(0x00);
      for(seg=0;seg<128;seg++)//DĄä128 ¨˘D
        {
          if(data1==1)send_data(0x00);
          else 	send_data(0xFF);
				}
    }
}

void lcd_clear_line8(unsigned char data1)
{
                                    //------¨°???¨ş????¨˘3¨ŹD¨°
    unsigned char seg;
   unsigned char page;
   for(page=0xb7;page<0xb8;page++) //DĄä¨°3ŚĚ??Ą¤128 ¨°3 0xb0----0xb8
    {
      send_command(page);
      send_command(0x10); //¨˘DŚĚ??Ą¤Ąę???ŚĚ¨ŞĄÁ??¨˛¨˘?Ąä?DĄä¨¨?Ąę?Ąä¨ŽŚĚ¨˛0 ¨˘D?a¨ş?
      send_command(0x00);
      for(seg=0;seg<128;seg++)//DĄä128 ¨˘D
        {
          if(data1==1)send_data(0x00);
          else 	send_data(0xFF);
				}
    }
}

const unsigned char char_Small[] = {
/*--  żíśČx¸ßśČ=5x8  --*/
                          // ASCIIÂë(HEX)  ×Öˇű
  0x00,0x00,0x00,0x00,0x00,       //20      żŐ°×
  0x00,0x00,0xBE,0x00,0x00,       //21       ŁĄ
  0x00,0x00,0x00,0x00,0x00,       //22       Ą°       żŐ
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  0x28,0x10,0x7C,0x10,0x28        //82        *
};

const unsigned char char_Medium[] = {
  /*--  żíśČx¸ßśČ=7x16  --*/
                                                                                  // ASCIIÂë(HEX)  ×Öˇű
  0xF8,0xFC,0x06,0x86,0xC6,0xFC,0xF8,0x3F,0x7F,0xC7,0xC3,0xC1,0x7F,0x3F,               //30         0
  0x00,0x18,0x1C,0xFE,0xFE,0x00,0x00,0x00,0xC0,0xC0,0xFF,0xFF,0xC0,0xC0,               //31         1
  0x1C,0x1E,0x0E,0x06,0x86,0xFE,0xFC,0xF8,0xFC,0xCE,0xC7,0xC3,0xC1,0xC0,               //32         2
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  0x0C,0x18,0x70,0xFE,0xFE,0x70,0x1C,0xC3,0x63,0x1B,0xFF,0xFF,0x3B,0x63                //43        *
};

const unsigned char char_RSSI[] = {
/*--  ľ÷ČëÁËŇťˇůÍźĎńŁşD:\My Documents\š¤×÷×ĘÁĎ\ČŐąžÎÄťŻ\ÎÄťŻ¸ÄĐÍ\TCXO°ć LCDÍźĎńĘýžÝ\NULL.bmp  --*/
/*--  żíśČx¸ßśČ=16x16  --*/
0xE0,0xF8,0x1C,0x0E,0x06,0x03,0x03,0x01,0x01,0x03,0x03,0x06,0x0E,0x1C,0xF8,0xE0,
0x07,0x1F,0x38,0x70,0x60,0xC0,0xC0,0x80,0x80,0xC0,0xC0,0x60,0x70,0x38,0x1F,0x07,
/*--  ľ÷ČëÁËŇťˇůÍźĎńŁşD:\My Documents\š¤×÷×ĘÁĎ\ČŐąžÎÄťŻ\ÎÄťŻ¸ÄĐÍ\TCXO°ć LCDÍźĎńĘýžÝ\o.bmp  --*/
/*--  żíśČx¸ßśČ=16x16  --*/
0xE0,0xF8,0xFC,0xFE,0xFE,0xFF,0xFF,0xFF,0xFF,0xFF,0xFF,0xFE,0xFE,0xFC,0xF8,0xE0,
0x07,0x1F,0x3F,0x7F,0x7F,0xFF,0xFF,0xFF,0xFF,0xFF,0xFF,0x7F,0x7F,0x3F,0x1F,0x07
};


const unsigned char char_rssi[] = {
/*--  ĺŽ˝ĺşŚxéŤĺşŚ=71x8  --*/                                                            //čżĺşŚćĄ

0xB8,0xB8,0xB8,0xB8,0xB8,0x80,0xB8,0xB8,0xB8,0xB8,0xB8,0x80,0xB8,0xB8,0xB8,0xB8,       //12
0xB8,0x80,0xB8,0xB8,0xB8,0xB8,0xB8,0x80,0xB8,0xB8,0xB8,0xB8,0xB8,0x80,0xB8,0xB8,
0xB8,0xB8,0xB8,0x80,0xB8,0xB8,0xB8,0xB8,0xB8,0x80,0xB8,0xB8,0xB8,0xB8,0xB8,0x80,
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0x80,0x80,0x80,0x80,0x80,0x80,0x80
};

const unsigned char char_Contro[] = {
0x00,0x00,0x00,0x80,0x80,0xC0,0xC0,0xC0,0xC0,0xC0,0xC0,0x80,0x80,0x00,0x00,0x00,
0x7C,0xFE,0xFF,0x83,0x01,0x01,0x00,0x00,0x00,0x00,0x01,0x01,0x83,0xFF,0xFF,0x7C,
0x00,0x01,0x01,0x03,0x03,0x07,0x06,0x06,0x06,0x06,0x07,0x03,0x03,0x01,0x00,0x00,/*"O",0*/
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0x00,0x07,0x07,0x07,0x06,0x06,0x06,0x06,0x06,0x06,0x06,0x06,0x00,0x00,0x00,0x00,/*"E",12*/

/*--  ÎÄ×Ö:  żŐ  --*/
0x00,0x00,0x00,0x00,0x00,0x00,0x00,0x00,0x00,0x00,0x00,0x00,0x00,0x00,0x00,0x00,
0x00,0x00,0x00,0x00,0x00,0x00,0x00,0x00,0x00,0x00,0x00,0x00,0x00,0x00,0x00,0x00,
0x00,0x00,0x00,0x00,0x00,0x00,0x00,0x00,0x00,0x00,0x00,0x00,0x00,0x00,0x00,0x00
};
